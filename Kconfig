## Kconfig
```kconfig
DT_COMPAT_COOL642TB_BATTERY_NIMH_DIVIDER := cool642tb,battery-nimh-divider

config COOL642TB_BATTERY_NIMH_DIVIDER
    bool
    default $(dt_compat_enabled,$(DT_COMPAT_COOL642TB_BATTERY_NIMH_DIVIDER))
    select ADC
    select ZMK_BATTERY
    depends on SENSOR
    help
        Battery voltage divider driver with NiMH 2S discharge curve.
```

## dts/bindings/sensor/cool642tb,battery-nimh-divider.yaml
```yaml
# Copyright (c) 2020 The ZMK Contributors
# SPDX-License-Identifier: MIT

description: Battery SoC monitoring using voltage divider (NiMH 2S curve)

compatible: "cool642tb,battery-nimh-divider"

include: voltage-divider.yaml
```
